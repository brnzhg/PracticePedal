## boards/shields/practice_pedal/Kconfig.defconfig
```kconfig
if SHIELD_PRACTICE_PEDAL

# Bluetooth name, 16 characters max
config ZMK_KEYBOARD_NAME
    default "PracticePedal"

endif
```

## boards/shields/practice_pedal/Kconfig.shield
```kconfig
config SHIELD_PRACTICE_PEDAL
    def_bool $(shields_list_contains,practice_pedal)
```
